## src/modules/radiation_detector/Kconfig
```kconfig
menuconfig MODULES_RADIATION_DETECTOR
	bool "Radiation Detector Module"
	default n
	---help---
		Enables RadiationDetector module which detects radiation
```
